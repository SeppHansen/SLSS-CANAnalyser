VERSION "Created by SeRoSys Technology"

NS_ :

BS_:

BU_:

VAL_ 674 TRANS 15 "Fault" 14 "UnknownPosition" 13 "Undefined_2" 12 "Undefined_1" 11 "_6" 10 "_5" 9 "_4" 8 "_3" 7 "_2" 6 "_1" 5 "Low" 4 "Sport_DriveSport" 3 "Drive" 2 "Neutral" 1 "Reverse" 0 "Park" ;

BO_ 674 Vehicle_Messages: 8 SLSS_XXX

BO_ 2147484747 CANFD_Ext_DBC_Signals: 16 SLSS__XXX

BO_ 1098 CANFD_DBC_Signals: 24 SLSS__XXX

BO_ 427 Channel_A_DBC: 8 SLSS_XXX
 SG_ CH_A_Test_Signal : 0|16@1+ (0,0) [0|1024] "Testing"  SLSS_XXX
 SG_ CH_A_Test_Signal_2 : 17|32@1+ (1,1) [0|2048] "Testing"  SLSS_XXX

BA_DEF_ "BusType" STRING;
BA_DEF_ BO_  "VFrameFormat" ENUM  "StandardCAN","ExtendedCAN","reserved","reserved","reserved","reserved","reserved","reserved","reserved","reserved","reserved","reserved","reserved","reserved","StandardCAN_FD","ExtendedCAN_FD";
BA_ "VFrameFormat" BO_ 1 14;
BA_ "VFrameFormat" BO_ 2147483650 15;
BA_ "BusType" "CAN FD";
